
;Select CPU type
setup.var %SPOTLIGHT 
LOCAL &param_cpu
&param_cpu=STRing.SCANAndExtract(STRing.UPpeR("&parameters"),"CPU=","")
SYStem.RESet
SYStem.CONFIG.DEBUGPORTTYPE DAP2
system.config.dap.USER1 SET HIGH 

IF SYStem.MODE()<5
(
    SYStem.RESet

    IF "&param_cpu"!=""
      SYStem.CPU &param_cpu
    IF !CPUIS(TC27*)
      SYStem.CPU TC27*

    SYStem.CONFIG.DEBUGPORTTYPE DAP2
    system.config.dap.USER1 SET HIGH 
)
;sys.cpu tc275te


;Create new window for printing the SPI rx values.
;AREA.Create OUT 
;AREA.Select OUT
;AREA.view OUT
;WinClear OUTWIN

; Wait for Power off
wait !STATE.POWER()
 
;Wait for power-ON
wait STATE.POWER()
   system.config.dap.USER1 SET HIGH 

sys.up
break.select.PROGRAM ONCHIP
;load target program and make required settings for target based programming


;;;;;;;;;;;;;;;;;;;;;;;;;;;;;;;;;;;;;;;;;;;;;;;;;;;;;;;;;;;;;;;;;;;;;;;;;;;;;;;;;;;;;;;;;;;;;;;;;;;
;Wait for ROT signal: Not required if polling just reset

;wait (data.long(D:0xF003C024)&0x8)==0x0 //Wait until a high is over
;wait (data.long(D:0xF003C024)&0x8)==0x8 //Wait until it goes high again for the next power-up cycle

;;;;;;;;;;;;;;;;;;;;;;;;;;;;;;;;;;;;;;;;;;;;;;;;;;;;;;;;;;;;;;;;;;;;;;;;;;;;;;;;;;;;;;;;;;;;;;;;;;;

;SPI init and sending commands should happen here

;SPI2_CLC = 0
Data.Set D:0xF0001E00 %LONG 0x8


;QSPI0_GLOBALCON.U = (0x4) | (0xF << 10)
Data.Set D:0xF0001E10 %LONG 0x03C04

;QSPI0_PISEL.U = 1
;P15.7 RxSel B for QSPI2
Data.Set D:0xF0001E04 %LONG 0x1

;QSPI0_GLOBALCON1.U = (0x1 << 26) | (0x1 << 28)
Data.Set D:0xF0001E14 %LONG 0x14000000

;QSPI0_ECON6.U = ((1) | (0x1 << 8) | (0x1 << 10))
Data.Set D:0xF0001E24 %LONG 0x413;0x501;

;QSPI0_SSOC.U = (0x1 << 18)
;enable CS 1 
Data.Set D:0xF0001E48 %LONG 0x00020000


;Ports
;P15.3 =>output for signalling end of procedure. 
;Pull it low 
Data.Set D:0xF003D314 %LONG 0x00800000
Data.Set D:0xF003D300 %LONG 0x00 

;P15.7=>Input MRST					20.12
;P15.3=>Output alt 3 SCL		20.11
;P15.6=>Output alt 3 MTSR	20.14
;P15_IOCR4  							
Data.Set D:0xF003B514 %LONG 0x00980000
;P15_IOCR0  							
Data.Set D:0xF003B510 %LONG 0x98000000



;Port 20 drive strength
Data.Set D:0xF003B540 %LONG 0x0
;Data.Set D:0xF003C044 %LONG 0x0


;P14.2=>Output alt3 CS09
;P14_IOCR0  							
Data.Set D:0xF003b410 %LONG 0x00980000
;Drive strength
;Data.Set D:0xF003B440 %LONG 0x0



;Make sure that flags in STATUS register are cleared 
;while ((QSPI0_STATUS.U & 0xFFF) != 0)
; QSPI0_FLAGSCLEAR.U = 0xFFF;
WAIT (data.long(D:0xF0001E40)&0xFFF)==0x0
Data.Set D:0xF0001E54 %LONG 0xFFF


;QSPI1_BACONENTRY.U = 0x1 |(0x1 << 16) | (0x1 << 21 /*MSB first*/) | (0 << 22) | (0xF << 23) | (0x9 << 28 /*CS 9*/) |(2<<13 /*TPRE 16*/) | (7<<16 /*TRAIL = 8*/);
;Data.Set D:0xF0001D60 %LONG 0x97A74001


;QSPI0_BACONENTRY.U = 0x1 |(0x1 << 16) | (0x1 << 21 /*MSB first*/) | (0 << 22) | (0xF << 23) | (0x1 << 28 /*CS 2*/);
Data.Set D:0xF0001E60 %LONG 0x17A74001

;QSPI0_GLOBALCON.B.EN = 1;
Data.Set D:0xF0001E10 %LONG (data.long(D:0xF0001E10)|0x01000000)


;Write the spi words
;{0x8756,0x87DE,0x86AD,0x8625,0x8D27,0x8811,0x87BE,0x8668,0x877D,0x8795};

;GOSUB write_spi_word 0x0C00 //Read WDCFG0
;GOSUB write_spi_word 0x0801 //Read SYSPCFG0

GOSUB write_spi_word 0x8756
GOSUB write_spi_word 0x87DE
GOSUB write_spi_word 0x86AD
GOSUB write_spi_word 0x8625
GOSUB write_spi_word 0x8D27
GOSUB write_spi_word 0x8811
GOSUB write_spi_word 0x87BE
GOSUB write_spi_word 0x8668
GOSUB write_spi_word 0x877D
GOSUB write_spi_word 0x8795

;Now read back the WDCFG0 and SYSPCFG0 registers to confirm the switch off.
GOSUB write_spi_word 0x0C00 //Read WDCFG0
GOSUB write_spi_word 0x0801 //Read SYSPCFG0
GOSUB write_spi_word 0x2800 //Read ProtStat

;Give a 50ms pulse on P33.6
Data.Set D:0xF003D300 %LONG 0x40
WAIT 50.ms
Data.Set D:0xF003D300 %LONG 0x00



 
 enddo



write_spi_word:
 ENTRY &spi_word
 &rx_data=0
 Data.Set D:0xF0001E64 %LONG &spi_word
 WAIT (data.long(D:0xF0001E40)&0x200)==0x200
 Data.Set D:0xF0001E54 %LONG 0x200

 WAIT (data.long(D:0xF0001E40)&0x400)==0x400
 Data.Set D:0xF0001E54 %LONG 0x400

 &rx_data=data.long(D:0xF0001E90)
 PRINT %Hex &rx_data ;may add to the delay.
 RETURN




































